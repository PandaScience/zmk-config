## config/west.yml
```yaml
manifest:
  remotes:
    - name: zmkfirmware
      url-base: https://github.com/zmkfirmware
    - name: urob
      url-base: https://github.com/urob
    - name: PandaScience
      url-base: https://github.com/PandaScience
  projects:
    - name: zmk
      remote: zmkfirmware
      revision: v0.3.0
      import: app/west.yml
    - name: zmk-adaptive-key
      remote: urob
      revision: v0.3 # Should match ZMK release.
    - name: zmk-auto-layer
      remote: urob
      revision: v0.3 # Should match ZMK release.
    - name: zmk-module-dasbob
      remote: PandaScience
      revision: main
  self:
    path: config
```
